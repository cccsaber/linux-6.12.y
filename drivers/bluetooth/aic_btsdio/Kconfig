## drivers/bluetooth/aic_btsdio/Kconfig
```kconfig
config AIC8800_BTSDIO_SUPPORT
	tristate "AIC8800 SDIO bluetooth Support"
	depends on AIC8800_SDIO_WLAN
	help
	  This is support for aic sdio bluetooh driver.
```

## drivers/net/wireless/aicsemi/aic8800/sdio/Kconfig
```kconfig
config AIC8800_SDIO_WLAN
	bool "AIC8800 SDIO WLAN Support"
	default y
	depends on AIC8800_SUPPORT
	depends on MMC
	help
	  Support AICSemi AIC8800 SDIO wireless.

config AIC8800_SDIO_FW_PATH
	string "Firmware & config file path"
	default "/lib/firmware/aic8800_sdio"
	depends on AIC8800_SDIO_WLAN
	help
	  Path to the firmware & config file.

if AIC8800_SDIO_WLAN
source "drivers/net/wireless/aicsemi/aic8800/sdio/fdrv/Kconfig"
endif
```

## drivers/net/wireless/aicsemi/aic8800/sdio/fdrv/Kconfig
```kconfig
config AIC8800_WLAN_SUPPORT
	tristate "AIC8800 wlan Support"
	default m if AIC8800_SDIO_WLAN
	help
	  This is support for aic wifi driver.
```

## drivers/net/wireless/aicsemi/aic8800/usb/Kconfig
```kconfig
config AIC8800_USB_WLAN
	bool "AIC8800 USB WLAN Support"
	default n
	depends on AIC8800_SUPPORT
	help
	  Support AICSemi AIC8800 USB wireless.

config AIC8800_USB_FW_PATH
	string "Firmware & config file path"
	default "/lib/firmware/aic8800_usb"
	depends on AIC8800_USB_WLAN
	help
	  Path to the firmware & config file.
```
